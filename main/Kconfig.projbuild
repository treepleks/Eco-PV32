## main/Kconfig.projbuild
```kconfig
menu "EcoPV32 configuration"
config WIFI_SSID
  string "SSID du point d'accès WiFi"
  help
	Entrez le SSID du point d'accès WiFi auquel EcoPV32 doit se connecter
config WIFI_PASS
  string "Mot de passe du point d'accès WiFi"
  help
	Entrez le mot de passe du point d'accès WiFi auquel EcoPV32 doit se connecter
config LINKY_STANDARD
  bool "Linky en mode standard"
  help
	Indiquez si le compteur Linky connecté à EcoPV32 est en mode standard.
	Si non, le compteur sera considéré comme étant en mode historique. Dans ce
	mode, il faut calibrer le décalage de phase manuellement.
config BROKER_URL
  string "Adresse IP du broker MQTT"
  help
	Adresse IP du broker MQTT
endmenu
```
